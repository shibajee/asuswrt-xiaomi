## release/src-mtk3.5/linux/linux-3.10.108/Kconfig
```kconfig
#
# For a description of the syntax of this configuration file,
# see Documentation/kbuild/kconfig-language.txt.
#
mainmenu "Linux/$ARCH $KERNELVERSION Kernel Configuration"

config SRCARCH
	string
	option env="SRCARCH"

config SUPPORT_OPENWRT
	bool "Support OpenWrt"
	default n

config PROJECT_7628
        bool "PROJECT 7628"
        default n

source "arch/$SRCARCH/Kconfig"
```

## release/src-mtk3.5/linux/linux-3.10.108/ralink/Kconfig.misc
```kconfig
menu "ASUS Miscellaneous options"

config  SINGLE_SKU_IN_DRIVER
        bool "Single sku in driver, not file"
        default n

config  MTD_JFFS2_LEN
        hex "MTD JFFS2 Partition Length (Unit:Bytes)"
        default 0x0

config  MODEL_RTAC1200V2
        bool "RT-AC1200_V2"
        default n

endmenu
```
